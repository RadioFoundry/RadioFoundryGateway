## common/Kconfig
```kconfig
# SPDX-License-Identifier: MIT
# SPDX-FileCopyrightText: 2026 The RadioFoundry Gateway authors
menu "RadioFoundry Gateway common (common)"

    config RDOF_FEATURE_TX
        bool "Transmit-side burst work (regenerate, CSBK preambles)"
        default y
        help
            What a simplex or duplex MMDVM modem must be handed. The roamer's
            transmit path needs it; a receive-only build doesn't.

    config RDOF_FEATURE_DATA_BLOCKS
        bool "Data block decode (trellis 3/4, rate 1, CRC-9, CRC-32)"
        default y
        help
            Decoding data blocks and confirmed data. The call tracker doesn't need it
            (it counts blocks), so a receive-only gateway can leave it out.

    config RDOF_FEATURE_TRACKER
        bool "Call tracker and HBlink sink"
        default y
        help
            The call tracker: call start / end JSON, raw bursts and DMRD for what the radio hears.

    config RDOF_FEATURE_REPEATER
        bool "Duplex and single frequency repeater"
        depends on RDOF_FEATURE_TX
        default y

    config RDOF_RUST
        bool "rust's modules in place of their C files"
        depends on RDOF_FEATURE_TX && RDOF_FEATURE_DATA_BLOCKS && RDOF_FEATURE_TRACKER && RDOF_FEATURE_REPEATER
        default n
        help
            common ported to Rust a module at a time (rust/README.md lists them).
            The Rust is the build with every feature on, so it needs them all.
            Needs Espressif's Rust toolchain (espup install --targets esp32s3 --std).

endmenu
```

## components/gnss/Kconfig
```kconfig
# SPDX-License-Identifier: MIT
# SPDX-FileCopyrightText: 2026 The RadioFoundry Gateway authors
menu "gnss (NMEA from a GNSS receiver)"

    config GNSS_UART_RX_GPIO
        int "GPIO the ESP receives NMEA on (the receiver's TX), -1 for none"
        range -1 48
        default -1
        help
            -1 builds the reader out. With autodetect, the RX and TX pins are tried swapped
            too, so a pin table that names them from either end still works.

    config GNSS_UART_TX_GPIO
        int "GPIO the ESP sends on (the receiver's RX), -1 for none"
        range -1 48
        default -1
        depends on GNSS_UART_RX_GPIO >= 0

    config GNSS_UART_NUM
        int "UART"
        range 0 2
        default 1
        depends on GNSS_UART_RX_GPIO >= 0

    config GNSS_BAUD
        int "Baud rate"
        default 9600
        depends on GNSS_UART_RX_GPIO >= 0
        help
            Most receivers (u-blox, Quectel L76K) start at 9600.

    config GNSS_AUTODETECT
        bool "No NMEA in 3 s: try the pins swapped and the usual baud rates"
        default y
        depends on GNSS_UART_RX_GPIO >= 0

    config GNSS_TASK_PRIORITY
        int "Reader task priority"
        range 1 24
        default 9
        depends on GNSS_UART_RX_GPIO >= 0
        help
            Above the web server: a chunk's time is when the task wakes for it.

    config GNSS_TASK_CORE
        int "Reader task core (-1: any)"
        range -1 1
        default 0
        depends on GNSS_UART_RX_GPIO >= 0

endmenu
```

## components/netclock/Kconfig
```kconfig
# SPDX-License-Identifier: MIT
# SPDX-FileCopyrightText: 2026 The RadioFoundry Gateway authors
menu "netclock (NTP disciplined clock)"

    config NETCLOCK_DEFAULT_SERVERS
        string "NTP servers until some are set"
        default "pool.ntp.org"
        help
            Names or addresses, space or comma separated (up to 6 servers). A name
            ending in pool.ntp.org counts as three (0., 1. and 2.). Settings stored in
            NVS replace this.

    config NETCLOCK_POLL_S
        int "Poll interval once the clock rate is learned (s)"
        range 16 3600
        default 300

    config NETCLOCK_POLL_FAST_S
        int "Poll interval while the clock rate is being learned (s)"
        range 16 3600
        default 120

    config NETCLOCK_START_ON_IP
        bool "Start polling on the first IP address (Wi-Fi, Ethernet or PPP)"
        default y
        help
            Off: the app calls netclock_start() itself.

    config NETCLOCK_SET_SYSTEM_TIME
        bool "Set the system time when the clock steps"
        default y
        help
            Keeps time() and log stamps roughly right. netclock_now_ns() doesn't use it.

    config NETCLOCK_DIE_TEMP
        bool "Record the chip temperature with each reference"
        depends on SOC_TEMP_SENSOR_SUPPORTED
        default y
        help
            The crystal's rate follows temperature: the status shows both.

    config NETCLOCK_PPS_GPIO
        int "GPIO of a GNSS receiver's pulse per second (-1: none)"
        range -1 48
        default -1
        help
            Each pulse is stamped in an interrupt; the clock as NTP or a browser set it
            numbers the seconds (it must be within 300 ms), and every 20th good pulse is a
            reference. The pulse leads the clock while it comes; NTP takes over 60 s after
            it stops. The pin gets a pull-down, so a missing receiver gives no edges.

    config NETCLOCK_PPS_FALLING
        bool "The second starts on the pulse's falling edge"
        depends on NETCLOCK_PPS_GPIO >= 0
        default n
        help
            Most receivers (u-blox, Quectel L76K) start the second on the rising edge.

    config NETCLOCK_GNSS_EVERY
        int "With no pulse: every Nth GNSS NMEA second is a reference"
        range 1 3600
        default 16

    config NETCLOCK_GNSS_LAG_MS
        int "With no pulse ever seen: the NMEA burst's start after the second (ms)"
        range 0 999
        default 0
        help
            Receivers send the second's sentences some tens to hundreds of ms after it
            starts. With a pulse, this is measured (the status's gnss_lag_ms); set it
            from that for a board without one.

    config NETCLOCK_HTTP
        bool "HTTP handlers and the page section (netclock_http_register)"
        default y

    config NETCLOCK_HTTP_BASE
        string "Path the JSON API sits under"
        depends on NETCLOCK_HTTP
        default "/api"

    config NETCLOCK_NVS_NAMESPACE
        string "NVS namespace for its settings and the learned rate"
        default "netclock"

    config NETCLOCK_TASK_PRIORITY
        int "NTP task priority"
        range 1 24
        default 8
        help
            Above the web server: reply stamps want a prompt wakeup.

    config NETCLOCK_TASK_CORE
        int "NTP task core (-1: any)"
        range -1 1
        default 0

endmenu
```

## components/tinysctp/Kconfig
```kconfig
# SPDX-License-Identifier: MIT
# SPDX-FileCopyrightText: 2026 The RadioFoundry Gateway authors
menu "tinysctp (SCTP over UDP)"

    config TINYSCTP_MAX_STREAMS
        int "Streams each way, at most"
        default 8
        range 1 1024
        help
            An association gets min(this, what each end asks for). Each costs 4 bytes.

    config TINYSCTP_RX_WINDOW
        int "Receive window, in chunks"
        default 64
        range 8 4096
        help
            DATA chunks held for reordering or reassembly; more arriving past it are
            dropped and sent again by the peer. 20 bytes each, plus the data held.

    config TINYSCTP_TASK_STACK
        int "Stack of the association's task (bytes)"
        default 4096

    config TINYSCTP_TASK_PRIORITY
        int "Priority of the association's task"
        default 8
        range 1 24

endmenu
```

## components/wifilist/Kconfig
```kconfig
# SPDX-License-Identifier: MIT
# SPDX-FileCopyrightText: 2026 The RadioFoundry Gateway authors
menu "wifilist (prioritized Wi-Fi networks)"

    config WIFILIST_MAX_NETWORKS
        int "Networks in the list"
        range 1 32
        default 8

    config WIFILIST_CONNECT_TIMEOUT_S
        int "Time to get an address from one network before trying the next (s)"
        range 5 120
        default 15

    config WIFILIST_RESCAN_MAX_S
        int "Longest wait between scans while nothing connects (s)"
        range 5 600
        default 30
        help
            The wait grows 5, 10, 20 s up to this; it's always this while the setup
            access point is up, since a scan takes the radio off the AP's channel.

    config WIFILIST_SOFTAP
        bool "Setup access point while there's no connection"
        default y

    config WIFILIST_HTTP
        bool "HTTP handlers and the page section (wifilist_http_register)"
        default y

    config WIFILIST_HTTP_BASE
        string "Path the JSON API sits under"
        depends on WIFILIST_HTTP
        default "/api"

    config WIFILIST_NVS_NAMESPACE
        string "NVS namespace for the list"
        default "wifilist"

    config WIFILIST_TASK_PRIORITY
        int "Station task priority"
        range 1 24
        default 5

endmenu
```
