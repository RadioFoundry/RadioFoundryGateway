// SPDX-License-Identifier: MIT AND BSD-2-Clause
// SPDX-FileCopyrightText: 2026 The RadioFoundry Gateway authors
/* The SSD1306 / SH1106 frame, its panel commands and the 5x7 font, plus the board's status screen. */
#include "rdof/oled.h"

#include <ctype.h>
#include <stdio.h>
#include <string.h>

/* The classic 5x7 bitmap font (Adafruit GFX glcdfont.c, BSD license), printable ASCII from 0x20. */
static const uint8_t GLYPHS[95 * 5] = {
    0x00, 0x00, 0x00, 0x00, 0x00,
    0x00, 0x00, 0x5F, 0x00, 0x00,
    0x00, 0x07, 0x00, 0x07, 0x00,
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    0x02, 0x01, 0x02, 0x04, 0x02,
};

static const uint8_t *glyph(char ch)
{
    unsigned c = (unsigned char)ch;
    if (c < 0x20 || c >= 0x20 + 95)
        c = '?';
    return &GLYPHS[(c - 0x20) * 5];
}

void rdof_oled_clear(rdof_frame_buf_t *f)
{
    memset(f->buf, 0, sizeof f->buf);
}

void rdof_oled_pixel(rdof_frame_buf_t *f, int x, int y, bool on)
{
    if (x < 0 || x >= RDOF_OLED_W || y < 0 || y >= RDOF_OLED_H)
        return;
    int i = (y >> 3) * RDOF_OLED_W + x;
    if (on)
        f->buf[i] |= (uint8_t)(1 << (y & 7));
    else
        f->buf[i] &= (uint8_t)~(1 << (y & 7));
}

bool rdof_oled_get(const rdof_frame_buf_t *f, int x, int y)
{
    if (x < 0 || x >= RDOF_OLED_W || y < 0 || y >= RDOF_OLED_H)
        return false;
    return (f->buf[(y >> 3) * RDOF_OLED_W + x] >> (y & 7)) & 1;
}

void rdof_oled_hline(rdof_frame_buf_t *f, int x0, int x1, int y, bool on)
{
    for (int x = x0; x <= x1; x++)
        rdof_oled_pixel(f, x, y, on);
}

void rdof_oled_rect(rdof_frame_buf_t *f, int x, int y, int w, int h, bool fill, bool on)
{
    if (fill) {
        for (int yy = y; yy < y + h; yy++)
            rdof_oled_hline(f, x, x + w - 1, yy, on);
        return;
    }
    rdof_oled_hline(f, x, x + w - 1, y, on);
    rdof_oled_hline(f, x, x + w - 1, y + h - 1, on);
    for (int yy = y; yy < y + h; yy++) {
        rdof_oled_pixel(f, x, yy, on);
        rdof_oled_pixel(f, x + w - 1, yy, on);
    }
}

/* The glyph columns drawn: all five, or (tight, not a letter or digit) its first lit one, or none. */
static int columns(const uint8_t *g, char ch, bool tight, int cols[5])
{
    int n = 0;
    if (tight && !isalnum((unsigned char)ch)) {
        for (int c = 0; c < 5 && !n; c++)
            if (g[c])
                cols[n++] = c;
        return n;
    }
    for (int c = 0; c < 5; c++)
        cols[n++] = c;
    return n;
}

int rdof_oled_text_width(const char *s, bool tight)
{
    int w = 0, cols[5];
    for (; *s; s++)
        w += columns(glyph(*s), *s, tight, cols) + 1;
    return w;
}

int rdof_oled_text(rdof_frame_buf_t *f, int x, int y, const char *s, bool invert, bool tight)
{
    int cols[5];
    for (; *s; s++) {
        if (x >= RDOF_OLED_W)
            break;
        const uint8_t *g = glyph(*s);
        int n = columns(g, *s, tight, cols);
        for (int k = 0; k <= n; k++) {
            uint8_t bits = k < n ? g[cols[k]] : 0;
            for (int row = 0; row < 8; row++)
                rdof_oled_pixel(f, x, y + row, (((bits >> row) & 1) != 0) != invert);
            x++;
        }
    }
    return x;
}

size_t rdof_oled_init_cmds(bool rotate180, int contrast, uint8_t *out, size_t cap)
{
    uint8_t seg = rotate180 ? 0xA0 : 0xA1, com = rotate180 ? 0xC0 : 0xC8;
    const uint8_t cmds[] = {0xAE, 0xD5, 0x80, 0xA8, 0x3F, 0xD3, 0x00, 0x40, 0x8D, 0x14, 0x20, 0x00, seg, com,
                            0xDA, 0x12, 0x81, (uint8_t)contrast, 0xD9, 0xF1, 0xDB, 0x40, 0xA4, 0xA6, 0xAF};
    size_t n = sizeof cmds < cap ? sizeof cmds : cap;
    memcpy(out, cmds, n);
    return n;
}

size_t rdof_oled_page_cmds(bool sh1106, int page, uint8_t *out, size_t cap)
{
    if (sh1106) {
        if (cap < 3)
            return 0;
        out[0] = (uint8_t)(0xB0 + page);
        out[1] = 0x02;
        out[2] = 0x10;
        return 3;
    }
    if (cap < 6)
        return 0;
    out[0] = 0x21;
    out[1] = 0;
    out[2] = RDOF_OLED_W - 1;
    out[3] = 0x22;
    out[4] = (uint8_t)page;
    out[5] = (uint8_t)page;
    return 6;
}

/* A health tag: inverted when up, struck through when down. */
static int tag(rdof_frame_buf_t *f, int x, int y, const char *s, bool up)
{
    int x1 = rdof_oled_text(f, x, y, s, up, false);
    if (!up)
        rdof_oled_hline(f, x, x1 - 2, y + 3, true);
    return x1 + 2;
}

void rdof_oled_render(rdof_frame_buf_t *f, const rdof_oled_status_t *s)
{
    char line[40];
    rdof_oled_clear(f);
    /* the network */
    snprintf(line, sizeof line, "%s %s", s->wifi ? "WiFi" : "no WiFi", s->ip ? s->ip : "");
    rdof_oled_text(f, 0, 0, line, false, true);
    /* health and the time */
    int x = tag(f, 0, 9, "MQ", s->mqtt);
    x = tag(f, x, 9, "HB", s->hblink);
    x = tag(f, x, 9, s->repeater ? "RPT" : "HAT", s->radio);
    if (s->clock && s->clock[0])
        rdof_oled_text(f, RDOF_OLED_W - rdof_oled_text_width(s->clock, false), 9, s->clock, false, false);
    rdof_oled_hline(f, 0, RDOF_OLED_W - 1, 18, true);
    /* where it is */
    if (s->repeater)
        snprintf(line, sizeof line, "%s %.4f/%.4f", s->name ? s->name : "", s->freq / 1e6, s->tx_freq / 1e6);
    else
        snprintf(line, sizeof line, "%s %.4f CC%d", s->name ? s->name : "", s->freq / 1e6, s->cc);
    rdof_oled_text(f, 0, 21, line, false, true);
    rdof_oled_text(f, 0, 30, s->state ? s->state : "", false, true);
    /* what it hears and sends */
    if (s->rx_line && s->rx_line[0]) {
        x = rdof_oled_text(f, 0, 41, "RX", s->rx_active, false);
        rdof_oled_text(f, x + 3, 41, s->rx_line, false, true);
    }
    rdof_oled_hline(f, 0, RDOF_OLED_W - 1, 51, true);
    x = rdof_oled_text(f, 0, 54, "TX", s->tx_active, false);
    rdof_oled_text(f, x + 3, 54, s->tx_line && s->tx_line[0] ? s->tx_line : "idle", false, true);
}
